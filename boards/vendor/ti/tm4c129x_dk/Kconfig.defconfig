## boards/vendor/ti/tm4c129x_dk/Kconfig.defconfig
```kconfig
# STM32H735G DISCOVERY board configuration

# Copyright (c) 2021 SILA Embedded Solutions GmbH
# SPDX-License-Identifier: Apache-2.0

if BOARD_TM4C129X_DK

# This doesn't seem to work.  RS.
# CONFIG_SERIAL=y
# CONFIG_CONSOLE=y
# CONFIG_UART_CONSOLE=y

if NETWORKING

config NET_L2_ETHERNET
	default y

endif # NETWORKING


endif # BOARD_TM4C129X_DK
```

## boards/vendor/ti/tm4c129x_dk/Kconfig.tm4c129x_dk
```kconfig
# Copyright (c) 2021 SILA Embedded Solutions GmbH
# SPDX-License-Identifier: Apache-2.0

config BOARD_TM4C129X_DK
	select SOC_TI_TM4C129XNC
# 	select SOC_TI_LM3S6965
```

## boards/vendor/ti/tm4c129x_dk/board.yml
```yaml
board:
  name: tm4c129x_dk
  vendor: TI
  socs:
#    - name: ti_lm3s6965
     - name: ti_tm4c129xnc
```

## drivers/serial/Kconfig.tiva
```kconfig
# SPDX-License-Identifier: Apache-2.0

menuconfig UART_TIVA
	bool "TI Tiva serial driver"
	default y
	depends on DT_HAS_TI_TIVA_UART_ENABLED
	select SERIAL_HAS_DRIVER
	select SERIAL_SUPPORT_INTERRUPT
	help
	  This option enables the TI Tiva serial driver.
	  This specific driver can be used for the serial hardware
	  available at the Texas Instrument LM3S6965 board.

if UART_TIVA

# ---------- Port 0 ----------

config UART_TIVA_PORT_0
	bool "TI Tiva UART Port 0"
	help
	  This tells the driver to configure the UART port at boot, depending on
	  the additional configure options below.

# ---------- Port 1 ----------

config UART_TIVA_PORT_1
	bool "TI Tiva UART Port 1"
	help
	  This tells the driver to configure the UART port at boot, depending on
	  the additional configure options below.

# ---------- Port 2 ----------

config UART_TIVA_PORT_2
	bool "TI Tiva UART Port 2"
	help
	  This tells the driver to configure the UART port at boot, depending on
	  the additional configure options below.

# ---------- Port 3 ----------

config UART_TIVA_PORT_3
	bool "TI Tiva UART Port 3"
	help
	  This tells the driver to configure the UART port at boot, depending on
	  the additional configure options below.

endif # UART_TIVA
```

## soc/ti/tm4c129xnc/Kconfig
```kconfig
# Copyright (c) 2014-2015 Wind River Systems, Inc.
# SPDX-License-Identifier: Apache-2.0

config SOC_TI_TM4C129XNC
	select ARM
	select CPU_CORTEX_M4
	select CPU_CORTEX_M_HAS_DWT
	select CPU_HAS_ARM_MPU
```

## soc/ti/tm4c129xnc/Kconfig.soc
```kconfig
# Copyright (c) 2014-2015 Wind River Systems, Inc.
# SPDX-License-Identifier: Apache-2.0

config SOC_TI_TM4C129XNC
	bool
	help
		TI TM4C129XNC

config SOC
	default "ti_tm4c129xnc" if SOC_TI_TM4C129XNC
```
